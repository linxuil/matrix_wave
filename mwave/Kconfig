## mwave/Kconfig
```kconfig
#
# For a description of the syntax of this configuration file,
# see the file kconfig-language.txt in the NuttX tools repository.
#

config MATH_MWAVE
	tristate "MatrixWave - multipl. of two matrices and sending results over SPI"
	default n
	---help---
		Enable \"MatrixWave\"
```
